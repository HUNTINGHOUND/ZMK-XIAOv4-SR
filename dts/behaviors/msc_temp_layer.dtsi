/*
 * Default node declaration. Users can override `layer` and `time-ms` by
 * redeclaring `msc_layer` in their keymap.
 */

/ {
    behaviors {
        /omit-if-no-ref/ msc_layer: msc_layer {
            compatible = "zmk,behavior-msc-temp-layer";
            #binding-cells = <1>;
            layer = <3>;
            time-ms = <500>;
        };
    };

    /* The behavior reports INPUT_REL_WHEEL/HWHEEL events on its own
     * device. An input-listener on this device forwards them to the
     * HID subsystem, mirroring how msc_input_listener is wired for
     * &msc upstream. Without this listener the events go nowhere.
     */
    msc_layer_input_listener: msc_layer_input_listener {
        compatible = "zmk,input-listener";
        device = <&msc_layer>;
    };
};
