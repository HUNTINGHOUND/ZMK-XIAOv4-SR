## Kconfig
```kconfig
config ZMK_BEHAVIOR_MSC_TEMP_LAYER
    bool "Mouse-scroll behavior that also keeps a temp layer alive"
    default y
    depends on DT_HAS_ZMK_BEHAVIOR_MSC_TEMP_LAYER_ENABLED
    depends on ZMK_POINTING
    help
      Each invocation emits a wheel event AND (re-)activates a configured
      keymap layer for a configured duration, so encoder rotation can keep
      the mouse layer alive without trackball motion.
```

## dts/bindings/zmk,behavior-msc-temp-layer.yaml
```yaml
description: |
  Mouse scroll wheel behavior bound directly to a sensor (no
  sensor-rotate-var wrapper). Two params: CW value and CCW value, both
  in MOVE_X/MOVE_Y encoding (e.g. SCRL_UP / SCRL_DOWN).

  On every raw sensor event (called via accept_data), reschedules the
  layer-disable timer so even slow rotations keep the layer alive
  between trigger crossings.

  On a trigger crossing (called via process when in TRIGGER mode), emits
  one INPUT_REL_WHEEL/HWHEEL event with the appropriate sign and
  re-activates the layer if it was deactivated by another mechanism.

compatible: "zmk,behavior-msc-temp-layer"

properties:
  label:
    type: string
    required: false
    deprecated: true
  "#sensor-binding-cells":
    type: int
    required: true
    const: 2
  layer:
    type: int
    required: true
    description: Index of the keymap layer to keep alive.
  time-ms:
    type: int
    default: 500
    description: Milliseconds to keep the layer active after the last raw sensor event.

sensor-binding-cells:
  - param1
  - param2
```
